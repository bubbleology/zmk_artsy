## config/boards/shields/artsyfartsy/Kconfig.defconfig
```kconfig
if SHIELD_THE_ARTSYFARTSY_LEFT || SHIELD_THE_ARTSYFARTSY_RIGHT

config ZMK_KEYBOARD_NAME
	default "artsyfartsy"

config I2C
	default y

endif
```

## config/boards/shields/artsyfartsy/Kconfig.shield
```kconfig
# Copyright (c) 2021 Mike "KemoNine" Crosson
# SPDX-License-Identifier: MIT

config SHIELD_ARTSYFARTSY
	def_bool $(shields_list_contains,artsyfartsy)
```
